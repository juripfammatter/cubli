## CMakeLists.txt
```
# SPDX-License-Identifier: Apache-2.0

cmake_minimum_required(VERSION 3.20.0)

find_package(Zephyr REQUIRED HINTS $ENV{ZEPHYR_BASE})
project(cpp_template)

FILE(GLOB app_sources src/*.cpp)
target_sources(app PRIVATE ${app_sources})
```

## prj.conf
```kconfig
#enable C++
CONFIG_CPP=y
CONFIG_STD_CPP20=y
CONFIG_CPP_EXCEPTIONS=y
CONFIG_GLIBCXX_LIBCPP=y
CONFIG_REQUIRES_FULL_LIBCPP=y

# enable printing floats
CONFIG_CBPRINTF_FP_SUPPORT=y
# enable logging 
# Level: [0,4]: [NONE, ERR, WRN, INF, DBG]
CONFIG_LOG=y
CONFIG_LOG_DEFAULT_LEVEL=3
CONFIG_LOG_MODE_MINIMAL=y 

# I2c
CONFIG_STDOUT_CONSOLE=y
CONFIG_I2C=y
```

## boards/m5stack_cores3_roller.overlay
```dts
//&i2c0 {
//	roller485: roller485@64 {
//		compatible = "m5stack,roller485";
//		reg = <0x64>;
//		status = "okay";
//	};
//};

//&pinctrl {
//    i2c0_default: i2c0_default {
//        group1 {
//            pinmux = <I2C0_SDA_GPIO12>, <I2C0_SCL_GPIO11>;
//        };
//    };
//};
```

## dts/bindings/m5stack,roller485.yaml
```yaml
description: Roller485 I2C device for M5Stack

compatible: "m5stack,roller485"

include: i2c-device.yaml

properties:
  irq-gpios:
    type: phandle-array
    description: |
      The INT1 and (optional) INT2 signal connections.
```

## src/main.cpp
```c
#include <cstdio>
#include "Testing.h"

int main(void)
{
	const uint8_t addr = 0x64;
	roller485tests::Roller485Tests test = roller485tests::Roller485Tests(addr);

	test.resetMotorPosition();
	test.runPositionModeTest();
	test.runCurrentModeTest();
	test.runSpeedModeTest();
	test.runEncoderModeTest();
}
```

## src/Roller485.cpp
```c
//
// Created by juri on 27.06.25.
//
#include "Roller485.h"

static inline void intToFourBytes(int32_t value, int8_t *bytes)
{
	*reinterpret_cast<int32_t *>(bytes) = static_cast<int32_t>(value);
}

static inline void intToFourBytesCurrent(int32_t value, int8_t *bytes)
{
	intToFourBytes(value * 100, bytes);
}

static inline void intToFourBytesSpeed(int32_t value, int8_t *bytes)
{
	intToFourBytes(value * 100, bytes);
}

static inline void intToFourBytesPosition(int32_t value, int8_t *bytes)
{
	intToFourBytes(value * 100, bytes);
}

static inline void floatToFourBytesPosition(float value, int8_t *bytes)
{
	intToFourBytes(static_cast<int32_t>(value * 100), bytes);
}

static inline void floatToFourBytesPD(float value, int8_t *bytes)
{
	intToFourBytes(static_cast<int32_t>(value * 100000), bytes);
}
static inline void floatToFourBytesI(float value, int8_t *bytes)
{
	intToFourBytes(static_cast<int32_t>(value * 10000000), bytes);
}

static inline int32_t fourBytesToInt(const int8_t *bytes)
{
	return *reinterpret_cast<const int32_t *>(bytes);
}

static inline int32_t fourBytesToIntCurrent(const int8_t *bytes)
{
	return fourBytesToInt(bytes) / 100;
}

static inline int32_t fourBytesToIntSpeed(const int8_t *bytes)
{
	return fourBytesToInt(bytes) / 100;
}

static inline int32_t fourBytesToIntPosition(const int8_t *bytes)
{
	return fourBytesToInt(bytes) / 100;
}

static inline float fourBytesToFloatPosition(const int8_t *bytes)
{
	return static_cast<float>(fourBytesToInt(bytes)) / 100.0f;
}

static inline float fourBytesToFloatPD(const int8_t *bytes)
{
	return static_cast<float>(fourBytesToInt(bytes)) / 100000.0f;
}

static inline float fourBytesToFloatI(const int8_t *bytes)
{
	return static_cast<float>(fourBytesToInt(bytes)) / 10000000.0f;
}

// TODO: add logging

namespace roller485
{
Roller485::Roller485(uint8_t i2c_address)
	: i2c_address(i2c_address), i2c_dev(DEVICE_DT_GET(DT_NODELABEL(i2c1)))
{
	if (!device_is_ready(i2c_dev)) {
		printk("I2C device not ready\n");
	}

	printk("Roller485 initialized with I2C address: 0x%02X\n", i2c_address);

	setRGBUserMode();
	disableMotor();
}

Roller485::~Roller485() = default;

int Roller485::sendAndCheck(uint8_t *data, size_t length)
{
	int ret = i2c_write(this->i2c_dev, data, length, this->i2c_address);
	if (ret != 0) {
		printk("Failed to send I2C command: %d\n", ret);
		return ret;
	}
	return 0;
}
void Roller485::enableMotor()
{
	uint8_t command[2] = {MOTOR_ENABLE, 0x01};
	if (sendAndCheck(command, 2) == 0) {
		motor_enabled = true;
		setRGBColor(0, 255, 0);
		printk("Motor enabled\n");
	} else {
		printk("Failed to enable motor\n");
		// TODO: Change to error state
	}
}

void Roller485::disableMotor()
{
	uint8_t command[2] = {MOTOR_ENABLE, 0x00};
	if (sendAndCheck(command, 2) == 0) {
		motor_enabled = false;
		setRGBColor(0, 0, 255);
		printk("Motor disabled\n");
	} else {
		printk("Failed to disable motor\n");
	}
}

void Roller485::setMode(Roller485::motor_mode_t mode)
{
	if (mode < SPEED_MODE || mode > ENCODER_MODE) {
		printk("Invalid motor mode: %d\n", mode);
		return;
	}

	uint8_t command[2] = {MOTOR_MODE, static_cast<uint8_t>(mode)};
	if (sendAndCheck(command, 2) == 0) {
		motor_mode = mode;
		printk("Motor mode set to %d\n", mode);
	} else {
		printk("Failed to set motor mode\n");
	}
}

void Roller485::setRGBUserMode()
{
	uint8_t command[2] = {RGB_USER_MODE, 0x01};
	if (sendAndCheck(command, 2) == 0) {
		printk("Motor mode set to user mode\n");
	} else {
		printk("Failed to set motor mode to user mode\n");
	}
}

void Roller485::setRGBColor(uint8_t red, uint8_t green, uint8_t blue)
{
	uint8_t command[4] = {RGB_COLOR, blue, green, red}; // BGR format
	if (sendAndCheck(command, 2) == 0) {
		//		printk("RGB color set to R:%d G:%d B:%d\n", red, green, blue);
	} else {
		printk("Failed to set RGB color\n");
	}
}
void Roller485::setMaxCurrent(int32_t max_current, Roller485::motor_mode_t mode)
{
	uint8_t address;
	int8_t max_current_bytes[4] = {0, 0, 0, 0};

	switch (mode) {
	case SPEED_MODE:
		address = SPEED_MODE_MAX_CURRENT;
		break;
	case POSITION_MODE:
		address = POSITION_MODE_MAX_CURRENT;
		break;
	case CURRENT_MODE:
		printk("Current mode does not support setting max current\n");
		return;
	case ENCODER_MODE:
		printk("Encoder mode does not support setting max current\n");
		return;
	default:
		printk("Invalid motor mode for setting max current\n");
		return;
	}

	intToFourBytesCurrent(max_current, max_current_bytes);

	printk("Max current bytes: 0x%02X 0x%02X 0x%02X 0x%02X\n", max_current_bytes[0],
	       max_current_bytes[1], max_current_bytes[2], max_current_bytes[3]);
	uint8_t command[5] = {address, static_cast<uint8_t>(max_current_bytes[0]),
			      static_cast<uint8_t>(max_current_bytes[1]),
			      static_cast<uint8_t>(max_current_bytes[2]),
			      static_cast<uint8_t>(max_current_bytes[3])};

	if (sendAndCheck(command, 5) == 0) {
		printk("Max current set to %d mA for mode %d\n",
		       fourBytesToIntCurrent(max_current_bytes), mode);
	} else {
		printk("Failed to set max current\n");
	}
}

void Roller485::setSpeed(int32_t speed)
{
	if (motor_mode != SPEED_MODE) {
		printk("Motor is not in speed mode, setting speed has no effect\n");
	}

	int8_t speed_bytes[4] = {0, 0, 0, 0};
	intToFourBytesSpeed(speed, speed_bytes);
	uint8_t command[5] = {SPEED_MODE_TARGET_SPEED, static_cast<uint8_t>(speed_bytes[0]),
			      static_cast<uint8_t>(speed_bytes[1]),
			      static_cast<uint8_t>(speed_bytes[2]),
			      static_cast<uint8_t>(speed_bytes[3])};

	printk("Speed bytes: 0x%02X 0x%02X 0x%02X 0x%02X\n", command[4], command[3], command[2],
	       command[1]);
	if (sendAndCheck(command, 5) == 0) {
		printk("Speed set to %d RPM\n", fourBytesToIntSpeed(speed_bytes));
	} else {
		printk("Failed to set speed\n");
	}
}

int32_t Roller485::getSpeed()
{
	if (motor_mode != SPEED_MODE) {
		printk("Motor is not in speed mode, getting speed has no effect\n");
	}

	uint8_t buffer[5] = {SPEED_MODE_READBACK_SPEED, 0, 0, 0, 0};
	i2c_write_read(i2c_dev, i2c_address, buffer, 1, &buffer[1], 4);
	int8_t data[4] = {static_cast<int8_t>(buffer[1]), static_cast<int8_t>(buffer[2]),
			  static_cast<int8_t>(buffer[3]), static_cast<int8_t>(buffer[4])};
	return fourBytesToIntSpeed(data);
}

void Roller485::setSpeedPID(float p, float i, float d)
{
	if (motor_mode != SPEED_MODE) {
		printk("Motor is not in speed mode, setting speed PID has no effect\n");
	}

	int8_t p_bytes[4] = {0, 0, 0, 0};
	int8_t i_bytes[4] = {0, 0, 0, 0};
	int8_t d_bytes[4] = {0, 0, 0, 0};

	floatToFourBytesPD(p, p_bytes);
	floatToFourBytesI(i, i_bytes);
	floatToFourBytesPD(d, d_bytes);

	uint8_t command[13] = {SPEED_MODE_PID_CONFIG,
			       static_cast<uint8_t>(p_bytes[0]),
			       static_cast<uint8_t>(p_bytes[1]),
			       static_cast<uint8_t>(p_bytes[2]),
			       static_cast<uint8_t>(p_bytes[3]),
			       static_cast<uint8_t>(i_bytes[0]),
			       static_cast<uint8_t>(i_bytes[1]),
			       static_cast<uint8_t>(i_bytes[2]),
			       static_cast<uint8_t>(i_bytes[3]),
			       static_cast<uint8_t>(d_bytes[0]),
			       static_cast<uint8_t>(d_bytes[1]),
			       static_cast<uint8_t>(d_bytes[2]),
			       static_cast<uint8_t>(d_bytes[3])};

	if (sendAndCheck(command, 13) == 0) {
		printk("Speed PID set to P: %f I: %f D: %f\n",
		       static_cast<double>(fourBytesToFloatPD(p_bytes)),
		       static_cast<double>(fourBytesToFloatI(i_bytes)),
		       static_cast<double>(fourBytesToFloatPD(d_bytes)));
	} else {
		printk("Failed to set speed PID\n");
	}
}

void Roller485::setPosition(float position)
{
	if (motor_mode != POSITION_MODE) {
		printk("Motor is not in position mode, setting position has no effect\n");
	}

	int8_t position_bytes[4] = {0, 0, 0, 0};
	floatToFourBytesPosition(position, position_bytes);
	uint8_t command[5] = {
		POSITION_MODE_TARGET_POSITION, static_cast<uint8_t>(position_bytes[0]),
		static_cast<uint8_t>(position_bytes[1]), static_cast<uint8_t>(position_bytes[2]),
		static_cast<uint8_t>(position_bytes[3])};

	printk("Position bytes: 0x%02X 0x%02X 0x%02X 0x%02X\n", command[4], command[3], command[2],
	       command[1]);

	if (sendAndCheck(command, 5) == 0) {
		printk("Position set to %.2f°\n",
		       static_cast<double>(fourBytesToFloatPosition(position_bytes)));
	} else {
		printk("Failed to set position\n");
	}
}

float Roller485::getPosition()
{
	if (motor_mode != POSITION_MODE) {
		printk("Motor is not in position mode, getting position has no effect\n");
		return 0;
	}

	uint8_t buffer[5] = {POSITION_MODE_READBACK_POSITION, 0, 0, 0, 0};
	i2c_write_read(i2c_dev, i2c_address, buffer, 1, &buffer[1], 4);
	int8_t data[4] = {static_cast<int8_t>(buffer[1]), static_cast<int8_t>(buffer[2]),
			  static_cast<int8_t>(buffer[3]), static_cast<int8_t>(buffer[4])};
	return fourBytesToFloatPosition(data);
}

void Roller485::setPositionPID(float p, float i, float d)
{
	if (motor_mode != POSITION_MODE) {
		printk("Motor is not in position mode, setting position PID has no effect\n");
		return;
	}

	int8_t p_bytes[4] = {0, 0, 0, 0};
	int8_t i_bytes[4] = {0, 0, 0, 0};
	int8_t d_bytes[4] = {0, 0, 0, 0};

	floatToFourBytesPD(p, p_bytes);
	floatToFourBytesI(i, i_bytes);
	floatToFourBytesPD(d, d_bytes);

	uint8_t command[13] = {POSITION_MODE_PID_CONFIG,         static_cast<uint8_t>(p_bytes[0]),
			       static_cast<uint8_t>(p_bytes[1]), static_cast<uint8_t>(p_bytes[2]),
			       static_cast<uint8_t>(p_bytes[3]), static_cast<uint8_t>(i_bytes[0]),
			       static_cast<uint8_t>(i_bytes[1]), static_cast<uint8_t>(i_bytes[2]),
			       static_cast<uint8_t>(i_bytes[3]), static_cast<uint8_t>(d_bytes[0]),
			       static_cast<uint8_t>(d_bytes[1]), static_cast<uint8_t>(d_bytes[2]),
			       static_cast<uint8_t>(d_bytes[3])};

	if (sendAndCheck(command, 13) == 0) {
		printk("Position PID set to P: %f I: %f D: %f\n",
		       static_cast<double>(fourBytesToFloatPD(p_bytes)),
		       static_cast<double>(fourBytesToFloatI(i_bytes)),
		       static_cast<double>(fourBytesToFloatPD(d_bytes)));
	} else {
		printk("Failed to set position PID\n");
	}
}

void Roller485::setCurrent(int32_t current)
{
	if (motor_mode != CURRENT_MODE) {
		printk("Motor is not in current mode, setting current has no effect\n");
	}
	int8_t current_bytes[4] = {0, 0, 0, 0};
	intToFourBytesCurrent(current, current_bytes);
	uint8_t command[5] = {CURRENT_MODE_CURRENT_TARGET, static_cast<uint8_t>(current_bytes[0]),
			      static_cast<uint8_t>(current_bytes[1]),
			      static_cast<uint8_t>(current_bytes[2]),
			      static_cast<uint8_t>(current_bytes[3])};

	printk("Current bytes: 0x%02X 0x%02X 0x%02X 0x%02X\n", command[4], command[3], command[2],
	       command[1]);

	if (sendAndCheck(command, 5) == 0) {
		printk("Current set to %d mA\n", fourBytesToIntCurrent(current_bytes));
	} else {
		printk("Failed to set current\n");
	}
}
int32_t Roller485::getEncoderCounter()
{
	if (motor_mode != ENCODER_MODE) {
		printk("Motor is not in encoder mode, getting encoder counter has no effect\n");
	}
	uint8_t buffer[5] = {ENCODER_COUNTER, 0, 0, 0, 0};
	i2c_write_read(i2c_dev, i2c_address, buffer, 1, &buffer[1], 4);
	printk("Encoder counter response: 0x%02X 0x%02X 0x%02X 0x%02X\n", buffer[4], buffer[3],
	       buffer[2], buffer[1]);
	int8_t data[4] = {static_cast<int8_t>(buffer[1]), static_cast<int8_t>(buffer[2]),
			  static_cast<int8_t>(buffer[3]), static_cast<int8_t>(buffer[4])};
	return fourBytesToInt(data);
}

} // namespace roller485
```

## src/Roller485.h
```c
//
// Created by juri on 27.06.25.
//

#ifndef CPP_TEMPLATE_ROLLER485_H
#define CPP_TEMPLATE_ROLLER485_H

#include <cstdio>
#include <cstdint>
#include <zephyr/kernel.h>
#include <zephyr/device.h>
#include <zephyr/drivers/i2c.h>

namespace roller485
{

class Roller485
{

      public:
	typedef enum {
		SPEED_MODE = 0x01,
		POSITION_MODE = 0x02,
		CURRENT_MODE = 0x03,
		ENCODER_MODE = 0x04,
	} motor_mode_t;

	explicit Roller485(uint8_t i2c_address);
	virtual ~Roller485();

	void enableMotor();
	void disableMotor();
	void setMode(motor_mode_t mode);
	void setRGBUserMode();
	void setRGBColor(uint8_t red, uint8_t green, uint8_t blue);
	void setMaxCurrent(int32_t max_current, motor_mode_t mode);
	void setSpeed(int32_t speed);
	int32_t getSpeed();
	void setSpeedPID(float p, float i, float d);
	void setPosition(float position);
	float getPosition();
	void setPositionPID(float p, float i, float d);
	void setCurrent(int32_t current);
	int32_t getCurrent();
	int32_t getInternalTemperature();
	int32_t getEncoderCounter();

      private:
	int sendAndCheck(uint8_t *data, size_t length);

	const uint8_t i2c_address;
	const struct device *i2c_dev;

	bool motor_enabled = false;
	motor_mode_t motor_mode = SPEED_MODE;

	typedef enum {
		MOTOR_ENABLE = 0x00,
		MOTOR_MODE = 0x01,
		MOTOR_OVER_RANGE_PROTECTION = 0x0A,
		REMOVE_JAM_PROTECTION = 0x0B,
		MOTOR_STATUS = 0x0C,
		MOTOR_ERROR_STATUS = 0x0D,
		ENABLE_BUTTON_MODE_SWITCHING = 0x0E,
		ENABLE_MOTOR_JAM_PROTECTION = 0x0F,
		DEVICE_ID = 0x10,
		RS485_BAUD_RATE = 0x11,
		RGB_LED_BRIGHTNESS = 0x12,
		POSITION_MODE_MAX_CURRENT = 0x20,
		RGB_COLOR = 0x30,
		RGB_USER_MODE = 0x33,
		POWER_VIN = 0x34,
		INTERNAL_TEMP = 0x38,
		ENCODER_COUNTER = 0x3C,
		SPEED_MODE_TARGET_SPEED = 0x40,
		SPEED_MODE_MAX_CURRENT = 0x50,
		SPEED_MODE_READBACK_SPEED = 0x60,
		SPEED_MODE_PID_CONFIG = 0x70,
		POSITION_MODE_TARGET_POSITION = 0x80,
		POSITION_MODE_READBACK_POSITION = 0x90,
		POSITION_MODE_PID_CONFIG = 0xA0,
		CURRENT_MODE_CURRENT_TARGET = 0xB0,
		CURRENT_MODE_READBACK_CURRENT = 0xC0,
		SAVE_FLASH = 0xF0,
		FIRMWARE_VERSION = 0xFE,
		I2C_ADDRESS = 0xFF,
	} i2c_address_t;
};

} // namespace roller485

#endif // CPP_TEMPLATE_ROLLER485_H
```

## src/Testing.cpp
```c
//
// Created by juri on 08.07.25.
//

#include "Testing.h"

namespace roller485tests
{

Roller485Tests::Roller485Tests(uint8_t i2c_address) : motor(i2c_address)
{
	printk("Roller485Tests initialized with I2C address: 0x%02X\n", i2c_address);
	printk("-------------Starting tests-------------\n");
	k_sleep(K_MSEC(100));
}

Roller485Tests::~Roller485Tests()
{
	printk("-------------Tests finished-------------\n");
}

void Roller485Tests::resetMotorPosition()
{
	motor.setMode(roller485::Roller485::POSITION_MODE);
	motor.setMaxCurrent(200.0f, roller485::Roller485::POSITION_MODE);
	k_sleep(K_MSEC(500));

	printk("Resetting motor position\n");
	motor.enableMotor();
	motor.setPositionPID(0.05f, 1.0f, 400.0f);
	motor.setPosition(0);
	k_sleep(K_MSEC(5000));
}
void Roller485Tests::runPositionModeTest()
{
	printk("-------------Position mode test-------------\n");
	motor.setMode(roller485::Roller485::POSITION_MODE);
	motor.setMaxCurrent(200.0f, roller485::Roller485::POSITION_MODE);
	k_sleep(K_MSEC(500));

	motor.setPositionPID(10.0f, 5.0f, 2000.0f);
	for (int i = 0; i < 5; i++) {

		motor.setPosition(360.5f);
		k_sleep(K_MSEC(2000));
		printk("Position: %.2f\n", static_cast<double>(motor.getPosition()));
		k_sleep(K_MSEC(100));
		motor.setPosition(-360.0f);
		k_sleep(K_MSEC(2000));
		printk("Position: %.2f\n", static_cast<double>(motor.getPosition()));
		k_sleep(K_MSEC(100));
	}
	motor.setPosition(0);
	k_sleep(K_MSEC(1000));
	motor.disableMotor();
}
void Roller485Tests::runCurrentModeTest()
{
	printk("-------------Current mode test-------------\n");
	motor.setMode(roller485::Roller485::CURRENT_MODE);
	motor.enableMotor();
	for (int i = 0; i < 5; i++) {

		motor.setCurrent(100.0f);
		k_sleep(K_SECONDS(1));
		printk("Current: %.2f mA\n", static_cast<double>(motor.getCurrent()));
		printk("Temperature: %.2f C\n",
		       static_cast<double>(motor.getInternalTemperature()));
		motor.setCurrent(-100.0f);
		k_sleep(K_SECONDS(1));
		printk("Current: %.2f mA\n", static_cast<double>(motor.getCurrent()));
	}
	motor.setCurrent(0.0f);
	k_sleep(K_SECONDS(3));
	motor.disableMotor();
}
void Roller485Tests::runSpeedModeTest()
{
	printk("-------------Speed mode test-------------\n");
	motor.setMode(roller485::Roller485::SPEED_MODE);
	motor.setMaxCurrent(1000, roller485::Roller485::SPEED_MODE);

	k_sleep(K_MSEC(500));
	motor.enableMotor();
	motor.setSpeedPID(15.0f, 0.0001f, 400.0f);
	for (int i = 0; i < 5; i++) {

		motor.setSpeed(1000.0f);
		k_sleep(K_MSEC(1000));
		printk("Speed: %f\n", static_cast<double>(motor.getSpeed()));
		printk("Temperature: %.2f C\n",
		       static_cast<double>(motor.getInternalTemperature()));

		k_sleep(K_MSEC(100));
		motor.setSpeed(-1000.0f);
		k_sleep(K_MSEC(1000));
		printk("Speed: %f\n", static_cast<double>(motor.getSpeed()));
		printk("Temperature: %.2f C\n",
		       static_cast<double>(motor.getInternalTemperature()));

		k_sleep(K_MSEC(100));
	}
	motor.setSpeed(0.0f);
	k_sleep(K_MSEC(1000));
	motor.disableMotor();
}
void Roller485Tests::runEncoderModeTest()
{
	printk("-------------Encoder mode test-------------\n");
	motor.setMode(roller485::Roller485::ENCODER_MODE);

	for (int i = 0; i < 50; i++) {
		printk("Encoder counter: %.2f\n", static_cast<double>(motor.getEncoderCounter()));
		k_sleep(K_MSEC(100));
	}
}
} // namespace roller485tests
```

## src/Testing.h
```c
//
// Created by juri on 08.07.25.
//

#ifndef CPP_TEMPLATE_TESTING_H
#define CPP_TEMPLATE_TESTING_H

#endif // CPP_TEMPLATE_TESTING_H

#include <cstdio>
#include <cstdint>
#include <zephyr/kernel.h>
#include <zephyr/device.h>
#include "Roller485.h"

namespace roller485tests
{

class Roller485Tests
{
      public:
	explicit Roller485Tests(uint8_t i2c_address);
	virtual ~Roller485Tests();

	void resetMotorPosition();
	void runPositionModeTest();
	void runCurrentModeTest();
	void runSpeedModeTest();
	void runEncoderModeTest();

      private:
	roller485::Roller485 motor;
};
} // namespace roller485tests
```
