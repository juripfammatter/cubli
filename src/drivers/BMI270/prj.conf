## CMakeLists.txt
```
#
# Copyright (c) 2018 Bosch Sensortec GmbH
#
# SPDX-License-Identifier: Apache-2.0
#

cmake_minimum_required(VERSION 3.20.0)
find_package(Zephyr REQUIRED HINTS $ENV{ZEPHYR_BASE})
project(bmi270)

FILE(GLOB app_sources src/*.cpp)
target_sources(app PRIVATE ${app_sources})
target_include_directories(app PRIVATE lib/eigen)
```

## prj.conf
```kconfig
#enable C++
CONFIG_CPP=y
CONFIG_STD_CPP20=y
CONFIG_CPP_EXCEPTIONS=y
CONFIG_GLIBCXX_LIBCPP=y
CONFIG_REQUIRES_FULL_LIBCPP=y

# enable printing floats
CONFIG_CBPRINTF_FP_SUPPORT=y

# enable logging
# CONFIG_LOG=y
# CONFIG_LOG_DEFAULT_LEVEL=1

# IMU
CONFIG_STDOUT_CONSOLE=y
CONFIG_I2C=y
CONFIG_SENSOR=y
```

## boards/m5stack_cores3.overlay
```dts
//&i2c0 {
//	bmi270@69 {
//		compatible = "bosch,bmi270";
//		reg = <0x69>;
//		status = "okay";
//	};
//};

//&pinctrl {
//    i2c0_default: i2c0_default {
//        group1 {
//            pinmux = <I2C0_SDA_GPIO12>, <I2C0_SCL_GPIO11>;
//        };
//    };
//};
```

## src/main.c
```c
/*
* Copyright (c) 2021 Bosch Sensortec GmbH
*
* SPDX-License-Identifier: Apache-2.0
*/

#include <zephyr/kernel.h>
#include <zephyr/device.h>
#include <zephyr/drivers/sensor.h>
#include <stdio.h>

int main(void)
{
       const struct device *const dev = DEVICE_DT_GET_ONE(bosch_bmi270);
       struct sensor_value acc[3], gyr[3];
       struct sensor_value full_scale, sampling_freq, oversampling;

       if (!device_is_ready(dev)) {
	       printf("Device %s is not ready\n", dev->name);
	       return 0;
       }

       printf("Device %p name is %s\n", dev, dev->name);

       /* Setting scale in G, due to loss of precision if the SI unit m/s^2
	* is used
	*/
       full_scale.val1 = 2;            /* G */
       full_scale.val2 = 0;
       sampling_freq.val1 = 100;       /* Hz. Performance mode */
       sampling_freq.val2 = 0;
       oversampling.val1 = 1;          /* Normal mode */
       oversampling.val2 = 0;

       sensor_attr_set(dev, SENSOR_CHAN_ACCEL_XYZ, SENSOR_ATTR_FULL_SCALE,
		       &full_scale);
       sensor_attr_set(dev, SENSOR_CHAN_ACCEL_XYZ, SENSOR_ATTR_OVERSAMPLING,
		       &oversampling);
       /* Set sampling frequency last as this also sets the appropriate
	* power mode. If already sampling, change to 0.0Hz before changing
	* other attributes
	*/
       sensor_attr_set(dev, SENSOR_CHAN_ACCEL_XYZ,
		       SENSOR_ATTR_SAMPLING_FREQUENCY,
		       &sampling_freq);


       /* Setting scale in degrees/s to match the sensor scale */
       full_scale.val1 = 500;          /* dps */
       full_scale.val2 = 0;
       sampling_freq.val1 = 100;       /* Hz. Performance mode */
       sampling_freq.val2 = 0;
       oversampling.val1 = 1;          /* Normal mode */
       oversampling.val2 = 0;

       sensor_attr_set(dev, SENSOR_CHAN_GYRO_XYZ, SENSOR_ATTR_FULL_SCALE,
		       &full_scale);
       sensor_attr_set(dev, SENSOR_CHAN_GYRO_XYZ, SENSOR_ATTR_OVERSAMPLING,
		       &oversampling);
       /* Set sampling frequency last as this also sets the appropriate
	* power mode. If already sampling, change sampling frequency to
	* 0.0Hz before changing other attributes
	*/
       sensor_attr_set(dev, SENSOR_CHAN_GYRO_XYZ,
		       SENSOR_ATTR_SAMPLING_FREQUENCY,
		       &sampling_freq);

       while (1) {
	       /* 10ms period, 100Hz Sampling frequency */
	       k_sleep(K_MSEC(10));

	       sensor_sample_fetch(dev);

	       sensor_channel_get(dev, SENSOR_CHAN_ACCEL_XYZ, acc);
	       sensor_channel_get(dev, SENSOR_CHAN_GYRO_XYZ, gyr);

	       printf("AX: %d.%06d; AY: %d.%06d; AZ: %d.%06d; "
		      "GX: %d.%06d; GY: %d.%06d; GZ: %d.%06d;\n",
		      acc[0].val1, acc[0].val2,
		      acc[1].val1, acc[1].val2,
		      acc[2].val1, acc[2].val2,
		      gyr[0].val1, gyr[0].val2,
		      gyr[1].val1, gyr[1].val2,
		      gyr[2].val1, gyr[2].val2);
       }
       return 0;
}
```

## src/main.cpp
```c
/*
* Copyright (c) 2021 Bosch Sensortec GmbH
*
* SPDX-License-Identifier: Apache-2.0
*/

#include <cstdio>
#include <zephyr/kernel.h>
#include <zephyr/device.h>
#include <zephyr/drivers/sensor.h>
#include <vector>
#include <array>
#include "../lib/eigen/Eigen/Core"

using Eigen::MatrixXf;
using Eigen::Matrix3f;
using Eigen::Vector3f;
using Eigen::Vector2f;

const int N = 1000;

void dump_measurements(std::vector<std::array<float, 7>> &measurements, std::vector<Vector3f> &state_estimates);

int main(void)
{
	const struct device *const dev = DEVICE_DT_GET_ONE(bosch_bmi270);
	struct sensor_value acc[3], gyr[3];
	struct sensor_value full_scale, sampling_freq, oversampling;

	if (!device_is_ready(dev)) {
	       printf("Device %s is not ready\n", dev->name);
	       return 0;
	}

	printf("Device %p name is %s\n", dev, dev->name);

	/* Setting scale in G, due to loss of precision if the SI unit m/s^2
	* is used
	*/
	full_scale.val1 = 2;            /* G */
	full_scale.val2 = 0;
	sampling_freq.val1 = 100;       /* Hz. Performance mode */
	sampling_freq.val2 = 0;
	oversampling.val1 = 1;          /* Normal mode */
	oversampling.val2 = 0;

	sensor_attr_set(dev, SENSOR_CHAN_ACCEL_XYZ, SENSOR_ATTR_FULL_SCALE,
		       &full_scale);
	sensor_attr_set(dev, SENSOR_CHAN_ACCEL_XYZ, SENSOR_ATTR_OVERSAMPLING,
		       &oversampling);
	/* Set sampling frequency last as this also sets the appropriate
	* power mode. If already sampling, change to 0.0Hz before changing
	* other attributes
	*/
	sensor_attr_set(dev, SENSOR_CHAN_ACCEL_XYZ,
		       SENSOR_ATTR_SAMPLING_FREQUENCY,
		       &sampling_freq);


	/* Setting scale in degrees/s to match the sensor scale */
	full_scale.val1 = 500;          /* dps */
	full_scale.val2 = 0;
	sampling_freq.val1 = 100;       /* Hz. Performance mode */
	sampling_freq.val2 = 0;
	oversampling.val1 = 1;          /* Normal mode */
	oversampling.val2 = 0;

	sensor_attr_set(dev, SENSOR_CHAN_GYRO_XYZ, SENSOR_ATTR_FULL_SCALE,
		       &full_scale);
	sensor_attr_set(dev, SENSOR_CHAN_GYRO_XYZ, SENSOR_ATTR_OVERSAMPLING,
		       &oversampling);
	/* Set sampling frequency last as this also sets the appropriate
	* power mode. If already sampling, change sampling frequency to
	* 0.0Hz before changing other attributes
	*/
	sensor_attr_set(dev, SENSOR_CHAN_GYRO_XYZ,
		       SENSOR_ATTR_SAMPLING_FREQUENCY,
		       &sampling_freq);


	printk("starting measurements\n");

	MatrixXf K(3,2);
	K<< 	0.70651668, -0.70652081,
		0.99958237,  0.00041399,
		0.00041691,  0.9995853;

	Matrix3f A;
	A << 	1.00000586,  0.01000003,  0.0,
		0.00117191,  1.00000586,  0.0,
		-0.00117191, -0.00000586,  1.0 ;

	MatrixXf C(2,3);
	C << 	0.00058595,  1.00000293,  0.0,
		-0.00058595, -0.00000293,  1.0;
	Matrix3f A_cl;
	A_cl = (A-K*C);

	// vector is allocated on heap
	std::vector<std::array<float, 7>> measurements(N, {{0.0}});
	std::vector<Vector3f> x_hat(N, Vector3f::Zero());
	Vector2f z_bar;

	x_hat[0] << 0.0, 0.0, 0.0; // initial state
	for (int i = 0; i < N; ++i) {

		k_sleep(K_MSEC(10));

		sensor_sample_fetch(dev);

		sensor_channel_get(dev, SENSOR_CHAN_ACCEL_XYZ, acc);
		sensor_channel_get(dev, SENSOR_CHAN_GYRO_XYZ, gyr);

		//wall time
		measurements[i][0] = float(k_uptime_get()) / 1000.0f; // convert to seconds
		measurements[i][1] = float(acc[0].val1) + float(acc[0].val2) / 1000000.0f;
		measurements[i][2] = float(acc[1].val1) + float(acc[1].val2) / 1000000.0f;
		measurements[i][3] = float(acc[2].val1) + float(acc[2].val2) / 1000000.0f;
		measurements[i][4] = float(gyr[0].val1) + float(gyr[0].val2) / 1000000.0f;
		measurements[i][5] = float(gyr[1].val1) + float(gyr[1].val2) / 1000000.0f;
		measurements[i][6] = float(gyr[2].val1) + float(gyr[2].val2) / 1000000.0f;

		if (i > 0) {
			// simple state update
			z_bar << measurements[i][6], 0.0; // acc x, y
			x_hat[i] = A_cl* x_hat[i-1] + K * z_bar;
		}
	}
	dump_measurements(measurements, x_hat);

	return 0;
}

void dump_measurements(std::vector<std::array<float, 7>> &measurements, std::vector<Vector3f> &state_estimates){
	for (int i = 0; i < N; ++i){
	       Vector3f state = state_estimates[i];
	       std::array m = measurements[i];
	       // print the measurements and state estimates
	       printk("time: [%0.6f], "
			      "imu: [%0.6f, %0.6f, %0.6f, %0.6f, %0.6f, %0.6f],"
			      "state: [%0.6f, %0.6f, %0.6f]\n",
			      double(m[0]),
			      double(m[1]), double(m[2]), double(m[3]),
			      double(m[4]), double(m[5]), double(m[6]),
			      double(state[0]), double(state[1]), double(state[2]));
       }

       k_sleep(K_SECONDS(2));
}
```
